## boards/shields/numlesskey/Kconfig.defconfig
```kconfig
if SHIELD_NUMLESSKEY_LEFT

config ZMK_KEYBOARD_NAME
    default "numlesskey"

endif

if SHIELD_NUMLESSKEY_LEFT || SHIELD_NUMLESSKEY_RIGHT

config ZMK_SPLIT
    default y

endif
```

## boards/shields/numlesskey/Kconfig.shield
```kconfig
config SHIELD_NUMLESSKEY_LEFT
    def_bool $(shields_list_contains,numlesskey_left)
config SHIELD_NUMLESSKEY_RIGHT
    def_bool $(shields_list_contains,numlesskey_right)
```
